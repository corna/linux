// Definitions for Silicon Labs' Si7020
/dts-v1/;
/plugin/;

/ {
	compatible = "brcm,bcm2708";

	fragment@0 {
		target = <&i2c1>;
		__overlay__ {
			#address-cells = <1>;
			#size-cells = <0>;
			status = "okay";

			si7020@40 {
				compatible = "silabs,si7020";
				reg = <0x40>;
			};
		};
	};
};
