// Definitions for Atmel's AT24C32
/dts-v1/;
/plugin/;

/ {
	compatible = "brcm,bcm2708";

	fragment@0 {
		target = <&i2c1>;
		__overlay__ {
			#address-cells = <1>;
			#size-cells = <0>;
			status = "okay";

			24c32@50 {
				compatible = "atmel,24c32";
				reg = <0x50>;
				pagesize = <32>;
			};
		};
	};
};
